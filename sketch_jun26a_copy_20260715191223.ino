#include <TFT_eSPI.h>
#include <stdint.h>
#include <string.h>
#include <stdlib.h>


#define BOTAO_1 4//A
#define BOTAO_2 27//B
#define BOTAO_3 14//Up
#define BOTAO_4 15//Down
#define BOTAO_5 13//Left
#define BOTAO_6 12//Right
#define CHIP8_WIDTH 64
#define CHIP8_HEIGHT 32
#define SCALE 5
#define FONT_START 0X050
#define ROM_START 0X200



// array size is 356
static const int8_t AIRPLANE[]  = {
  0x6a, 0x00, 0x6b, 0x04, 0x6c, 0x01, 0x6d, 0x00, 0x6e, 0x02, 0x23, 0x26, 0x23, 0x20, 0x60, 0x30, 
  0x61, 0x01, 0xf0, 0x15, 0xf0, 0x07, 0xf1, 0x18, 0x30, 0x00, 0x12, 0x14, 0x22, 0x42, 0x23, 0x20, 
  0x7d, 0x01, 0x23, 0x20, 0x60, 0x08, 0xe0, 0xa1, 0x23, 0x0a, 0x4a, 0x00, 0x12, 0x3e, 0xa3, 0x62, 
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  0xa8, 0xa0, 0x80, 0x00
};


// array size is 494
static const int8_t TETRIS[]  = {
  0xa2, 0xb4, 0x23, 0xe6, 0x22, 0xb6, 0x70, 0x01, 0xd0, 0x11, 0x30, 0x25, 0x12, 0x06, 0x71, 0xff, 
  0xd0, 0x11, 0x60, 0x1a, 0xd0, 0x11, 0x60, 0x25, 0x31, 0x00, 0x12, 0x0e, 0xc4, 0x70, 0x44, 0x70, 
  0x12, 0x1c, 0xc3, 0x03, 0x60, 0x1e, 0x61, 0x03, 0x22, 0x5c, 0xf5, 0x15, 0xd0, 0x14, 0x3f, 0x01, 
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  0xf2, 0x65, 0xa2, 0xb4, 0x00, 0xee, 0x6a, 0x00, 0x60, 0x19, 0x00, 0xee, 0x37, 0x23
};



// array size is 264
const uint8_t PONG[]  = {
  0x22, 0xf6, 0x6b, 0x0c, 0x6c, 0x3f, 0x6d, 0x0c, 0xa2, 0xea, 0xda, 0xb6, 0xdc, 0xd6, 0x6e, 0x00, 
  0x22, 0xd4, 0x66, 0x03, 0x68, 0x02, 0x60, 0x60, 0xf0, 0x15, 0xf0, 0x07, 0x30, 0x00, 0x12, 0x1a, 
  0xc7, 0x17, 0x77, 0x08, 0x69, 0xff, 0xa2, 0xf0, 0xd6, 0x71, 0xa2, 0xea, 0xda, 0xb6, 0xdc, 0xd6, 
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  0x3c, 0x20, 0x12, 0xfc, 0x6a, 0x00, 0x00, 0xee
};


const uint8_t FONTSET[80] = {
    0xF0, 0x90, 0x90, 0x90, 0xF0, // 0
    0x20, 0x60, 0x20, 0x20, 0x70, // 1
    0xF0, 0x10, 0xF0, 0x80, 0xF0, // 2
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    0xF0, 0x80, 0xF0, 0x80, 0x80  // F
};



struct Chip_8{
    
    uint8_t V[16];
    uint16_t I;
    uint16_t PC;
    uint8_t StackPointer;
    uint8_t DelayTimer;
    uint8_t SoundTimer;
    uint16_t stack[16];
    uint8_t memory[4096];
    uint8_t display[64][32];
    uint8_t keypad[16];

};

int gameChose = 0;
struct Chip_8 chip8;
TFT_eSPI tft = TFT_eSPI();
bool drawFlag = false;

void load_font();
void load_rom();
void fetch_and_decode(uint16_t opcode);
void render_display();
void read_input();




void setup() {
    


  bool running = true;
  tft.init();
  tft.setRotation(1);
  pinMode(BOTAO_1, INPUT_PULLUP);
  pinMode(BOTAO_2, INPUT_PULLUP);
  pinMode(BOTAO_3, INPUT_PULLUP);
  pinMode(BOTAO_4, INPUT_PULLUP);
  pinMode(BOTAO_5, INPUT_PULLUP);
  pinMode(BOTAO_6, INPUT_PULLUP);
  tft.fillScreen(TFT_BLACK);
  while(running){
    tft.setCursor(100, 50);
    tft.setTextColor(gameChose == 0 ? TFT_RED : TFT_WHITE);
    tft.println("PONG");
    tft.setTextColor(gameChose == 1 ? TFT_RED : TFT_WHITE);
    tft.println("TETRIS");
    tft.setTextColor(gameChose == 2 ? TFT_RED : TFT_WHITE);
    tft.println("AIRPLANE");


    if(digitalRead(BOTAO_3) == LOW){ 
        gameChose++;
        if(gameChose > 2){
            gameChose = 0;
        }
        delay(200);
    }
    if(digitalRead(BOTAO_4      ) == LOW){
        gameChose--;
        if(gameChose < 0){
            gameChose = 2;
        }
        delay(200);
    }
    if(digitalRead(BOTAO_1) == LOW){
        running = false;
    }


}



  load_font();
  load_rom();
  chip8.PC = ROM_START;



}

void loop() {
    read_input();

  for (int i = 0; i < 10; i++){
    uint16_t opcode = (chip8.memory[chip8.PC]<<8 | chip8.memory[chip8.PC+1]);
      chip8.PC+=2;

      fetch_and_decode(opcode);
      }


      if(chip8.DelayTimer > 0){
        chip8.DelayTimer--;
      }

      if(chip8.SoundTimer > 0){
        chip8.SoundTimer--;
      }
  
    if(drawFlag){
        render_display();
        drawFlag = false;
    }

}

void read_input(){
    if(gameChose == 0){
    chip8.keypad[0x1] = (digitalRead(BOTAO_1) == LOW);//A
    chip8.keypad[0x4] = (digitalRead(BOTAO_2) == LOW);//B
    chip8.keypad[0xC] = (digitalRead(BOTAO_3) == LOW);//Cima
    chip8.keypad[0xD] = (digitalRead(BOTAO_4) == LOW);//baixo
    }else if(gameChose == 1){
        chip8.keypad[0x5] = (digitalRead(BOTAO_5) == LOW); //esquerda
        chip8.keypad[0x6] = (digitalRead(BOTAO_6) == LOW); //direita
        chip8.keypad[0x4] = (digitalRead(BOTAO_1) == LOW); //A
    }else if(gameChose ==2){
        chip8.keypad[0x8] = (digitalRead(BOTAO_1) == LOW); //A
    }

}


void load_font(){
  for(int i = 0;i<sizeof(FONTSET)/sizeof(FONTSET[0]);i++){
    chip8.memory[FONT_START + i] = FONTSET[i];
  }
}

void load_rom(){
    switch(gameChose){
        case 0:
              for(int i = 0; i < sizeof(PONG)/sizeof(PONG[0]); i++){
                chip8.memory[ROM_START + i] = PONG[i];

                }
                break;
        case 1:
                for(int i = 0; i < sizeof(TETRIS)/sizeof(TETRIS[0]); i++){
                chip8.memory[ROM_START + i] = TETRIS[i];

                }
                break;
        case 2:
                for(int i = 0; i < sizeof(AIRPLANE)/sizeof(AIRPLANE[0]); i++){
                chip8.memory[ROM_START + i] = AIRPLANE[i];

                }
                break;
        default:
                break;
    }
}


void fetch_and_decode(uint16_t opcode){

    switch ((opcode & 0xF000) >> 12)
    {

    case 0x0: {

        if((opcode & 0x000F) == 0x0){
            memset(chip8.display, 0, sizeof(chip8.display));
            tft.fillScreen(TFT_BLACK);
        }else{
            chip8.StackPointer--;
            chip8.PC = chip8.stack[chip8.StackPointer];
        }

        break;
    }

    case 0x1: {

        chip8.PC = (opcode & 0x0FFF);

        break;
    }

    case 0x2: {

        chip8.stack[chip8.StackPointer] = chip8.PC;
        chip8.StackPointer++;

        chip8.PC = opcode & 0x0FFF;

        break;
    }

    case 0x3: {

        if((opcode & 0x00FF) == chip8.V[(opcode & 0x0F00) >> 8]){
            chip8.PC += 2;
        }

        break;
    }

    case 0x4: {

        if((opcode & 0x00FF) != chip8.V[(opcode & 0x0F00) >> 8]){
            chip8.PC += 2;
        }

        break;
    }

    case 0x5: {

        if(chip8.V[(opcode & 0x0F00) >> 8] ==
           chip8.V[(opcode & 0x00F0) >> 4]){

            chip8.PC += 2;
        }

        break;
    }

    case 0x6: {

        chip8.V[(opcode & 0x0F00) >> 8] = opcode & 0x00FF;

        break;
    }

    case 0x7: {

        chip8.V[(opcode & 0x0F00) >> 8] += opcode & 0x00FF;

        break;
    }

    case 0x8: {

        uint8_t last_bit = opcode & 0x000F;

        switch(last_bit){

            case 0x0: {

                chip8.V[(opcode & 0x0F00) >> 8] =
                chip8.V[(opcode & 0x00F0) >> 4];

                break;
            }

            case 0x1: {

                chip8.V[(opcode & 0x0F00) >> 8] =
                chip8.V[(opcode & 0x0F00) >> 8] |
                chip8.V[(opcode & 0x00F0) >> 4];

                break;
            }

            case 0x2: {

                chip8.V[(opcode & 0x0F00) >> 8] =
                chip8.V[(opcode & 0x0F00) >> 8] &
                chip8.V[(opcode & 0x00F0) >> 4];

                break;
            }

            case 0x3: {

                chip8.V[(opcode & 0x0F00) >> 8] =
                chip8.V[(opcode & 0x0F00) >> 8] ^
                chip8.V[(opcode & 0x00F0) >> 4];

                break;
            }

            case 0x4: {

                uint16_t sum =
                    chip8.V[(opcode & 0x0F00) >> 8] +
                    chip8.V[(opcode & 0x00F0) >> 4];

                if(sum > 255){
                    chip8.V[0xF] = 1;
                }else{
                    chip8.V[0xF] = 0;
                }

                chip8.V[(opcode & 0x0F00) >> 8] = sum;

                break;
            }

            case 0x5: {

                if(chip8.V[(opcode & 0x0F00)>>8] >= chip8.V[(opcode & 0x00F0)>>4]){
                    chip8.V[0xF] = 1;
                }else{
                    chip8.V[0xF] = 0;
                }

                chip8.V[(opcode & 0x0F00)>>8] =  chip8.V[(opcode & 0x0F00)>>8] - chip8.V[(opcode & 0x00F0)>>4];




                break;
            }

            case 0x6: {

                chip8.V[0xF] =
                    chip8.V[(opcode & 0x00F0) >> 4] & 0x1;

                chip8.V[(opcode & 0x0F00) >> 8] =
                    chip8.V[(opcode & 0x00F0) >> 4] >> 1;

                break;
            }

            case 0x7: {



                if(chip8.V[(opcode & 0x00F0)>>4] >= chip8.V[(opcode & 0x0F00) >> 8]){
                    chip8.V[0xF] = 1;
                }else{
                    chip8.V[0xF] = 0;
                }

                chip8.V[(opcode & 0x0F00) >> 8] = chip8.V[(opcode & 0x00F0)>>4] - chip8.V[(opcode & 0x0F00) >> 8];

                break;
            }

            case 0xE: {

                chip8.V[0xF] =
                    (chip8.V[(opcode & 0x00F0) >> 4] & 0x80) >> 7;

                chip8.V[(opcode & 0x0F00) >> 8] =
                    chip8.V[(opcode & 0x00F0) >> 4] << 1;

                break;
            }
        }

        break;
    }

    case 0x9: {

        if(chip8.V[(opcode & 0x0F00) >> 8] !=
           chip8.V[(opcode & 0x00F0) >> 4]){

            chip8.PC += 2;
        }

        break;
    }

    case 0xA: {

        chip8.I = opcode & 0x0FFF;

        break;
    }

    case 0xB: {

        chip8.PC =
            (opcode & 0x0FFF) + chip8.V[0x0];

        break;
    }
    case 0xC: {
        chip8.V[(opcode & 0x0F00)>>8] = (rand() % 256) & (opcode & 0x00FF);



        break;

    }
    case 0xD: {
        uint8_t x_index = (opcode & 0x0F00) >> 8;
        uint8_t y_index = (opcode & 0x00F0) >> 4;
        uint8_t height = opcode & 0x000F;

        uint8_t x_pos = chip8.V[x_index] % 64;
        uint8_t y_pos = chip8.V[y_index] % 32;

        chip8.V[0xF] = 0;

        for(int row = 0; row < height; row++){
            uint8_t sprite_byte = chip8.memory[chip8.I + row];

            for(int col = 0; col < 8; col++){
                uint8_t sprite_pixel = (sprite_byte >> (7 - col)) & 0x1;

                if(sprite_pixel){
                    int screen_x = (x_pos + col) % 64;
                    int screen_y = (y_pos + row) % 32;

                    if(chip8.display[screen_x][screen_y] == 1){
                        chip8.V[0xF] = 1;
                    }

                    chip8.display[screen_x][screen_y] ^= 1;
                }
            }
        }
        drawFlag = true;

    break;
    }

    case 0xE:{
        uint8_t last_byte = opcode & 0x00FF;

        switch (last_byte)
        {
        case 0x9E: {
            if(chip8.keypad[chip8.V[(opcode & 0x0F00)>>8]]){
                chip8.PC+=2;
            }
        }

            break;

        case 0xA1:{
            if(!chip8.keypad[chip8.V[(opcode & 0x0F00)>>8]]){
                chip8.PC+=2;
            }
        }

        break;
        
        default:
            break;
        }

    }
    
    break;

    case 0xF: {
        uint8_t last_byte = opcode & 0x00FF;

        switch (last_byte)
        {
        case 0x07:{
            chip8.V[(opcode & 0x0F00)>>8] = chip8.DelayTimer;

        }
            
            break;

        case 0x0A:{
            uint8_t x = (opcode & 0x0F00) >> 8;

            int keypressed = -1;

            for(int i = 0; i<16; i++){
                if(chip8.keypad[i]){
                    keypressed = i;
                    break;
                }
            }

            if(keypressed == -1){
                chip8.PC-=2;
            }else{
                chip8.V[x] = keypressed;
            }

        }

        break;

        case 0x15:{
            chip8.DelayTimer = chip8.V[(opcode & 0x0F00)>>8];

        }

        break;

        case 0x18: {
            chip8.SoundTimer = chip8.V[(opcode & 0x0F00)>>8];


        }
        break;

        case 0x1E: {
            chip8.I += chip8.V[(opcode & 0x0F00)>>8];
        }
        break;

        case 0x29:{
            uint8_t x = (opcode & 0x0F00) >> 8;
            uint8_t digit = chip8.V[x] & 0x0F;


            chip8.I = FONT_START + (digit * 5);

        }
        break;

        case 0x33:{
            uint8_t valor = chip8.V[(opcode & 0x0F00)>>8];

            chip8.memory[chip8.I] = valor / 100;
            chip8.memory[chip8.I+1] = (valor / 10) % 10;
            chip8.memory[chip8.I+2] = valor % 10;

            break;

        }
        case 0x55:{
            uint8_t x = (opcode & 0x0F00) >> 8;

            for(int i = 0; i<=x;i++){
                chip8.memory[chip8.I+i] = chip8.V[i];
            }

            chip8.I += x+1;



            break;
        }
        case 0x65:{           
            uint8_t x = (opcode & 0x0F00) >> 8;

            for(int i = 0; i <= x; i++){
                chip8.V[i] = chip8.memory[chip8.I + i];
            }

            chip8.I += x + 1;

            break;

        }

        default:
            break;
        }



        break;

    }

    default: {

        break;
    }

    }
}



void render_display(){

  for(int x = 0; x < 64; x++){
    for(int y = 0; y<32;y++){


        tft.fillRect(x * SCALE, y * SCALE, SCALE, SCALE,chip8.display[x][y] ? TFT_WHITE : TFT_BLACK);

        
    }
  }
}

